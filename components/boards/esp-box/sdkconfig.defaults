## components/boards/esp-box/sdkconfig.defaults
```kconfig
CONFIG_IDF_TARGET="esp32s3"

# Override some defaults so BT stack is enabled
CONFIG_BT_ENABLED=y
CONFIG_BTDM_CTRL_MODE_BLE_ONLY=y
CONFIG_BTDM_CTRL_MODE_BR_EDR_ONLY=n
CONFIG_BTDM_CTRL_MODE_BTDM=n
CONFIG_BT_NIMBLE_ENABLED=y
CONFIG_BT_NIMBLE_TASK_STACK_SIZE=8192

CONFIG_ESP_CONSOLE_USB_SERIAL_JTAG=y

CONFIG_ESP_RMAKER_FACTORY_PARTITION_NAME="nvs"

CONFIG_ESP_SYSTEM_EVENT_TASK_STACK_SIZE=4096

CONFIG_ESP32S3_SPIRAM_SUPPORT=y

CONFIG_EXTENDED_VFS_SPI=n

CONFIG_ESPTOOLPY_FLASHMODE_QIO=y
CONFIG_ESPTOOLPY_FLASHSIZE_16MB=y

CONFIG_MBEDTLS_EXTERNAL_MEM_ALLOC=y

CONFIG_PARTITION_TABLE_CUSTOM=y
CONFIG_PARTITION_TABLE_CUSTOM_FILENAME="components/boards/esp-box/partitions.csv"

CONFIG_SPIRAM_MALLOC_ALWAYSINTERNAL=0
CONFIG_SPIRAM_MODE_OCT=y
CONFIG_SPIRAM_MALLOC_RESERVE_INTERNAL=8192

CONFIG_LITTLEFS_FCNTL_GET_PATH=y
CONFIG_LITTLEFS_OPEN_DIR=y
CONFIG_LITTLEFS_SPIFFS_COMPAT=y

CONFIG_LV_FONT_FMT_TXT_LARGE=y
CONFIG_LV_FONT_MONTSERRAT_8=y
CONFIG_LV_FONT_MONTSERRAT_10=y
CONFIG_LV_FONT_MONTSERRAT_12=y
CONFIG_LV_FONT_MONTSERRAT_14=y
CONFIG_LV_FONT_MONTSERRAT_16=y
CONFIG_LV_FONT_MONTSERRAT_18=y
CONFIG_LV_FONT_MONTSERRAT_20=y
CONFIG_LV_FONT_MONTSERRAT_22=y
CONFIG_LV_FONT_MONTSERRAT_24=y
CONFIG_LV_FONT_MONTSERRAT_26=y
CONFIG_LV_FONT_MONTSERRAT_28=y
CONFIG_LV_FONT_MONTSERRAT_30=y
CONFIG_LV_FONT_MONTSERRAT_32=y
CONFIG_LV_FONT_MONTSERRAT_34=y
CONFIG_LV_FONT_MONTSERRAT_36=y
CONFIG_LV_FONT_MONTSERRAT_38=y
CONFIG_LV_FONT_MONTSERRAT_40=y
CONFIG_LV_FONT_MONTSERRAT_42=y
CONFIG_LV_FONT_MONTSERRAT_44=y
CONFIG_LV_FONT_MONTSERRAT_46=y
CONFIG_LV_FONT_MONTSERRAT_46=y
CONFIG_LV_FONT_MONTSERRAT_48=y
CONFIG_LV_MEM_CUSTOM=y
CONFIG_LV_MEMCPY_MEMSET_STD=y
CONFIG_LV_SPRINTF_CUSTOM=y
CONFIG_LV_USE_FS_STDIO='S'

CONFIG_LV_USE_QRCODE=y

CONFIG_WASMACHINE_APP_MGR=y
CONFIG_WASMACHINE_WASM_EXT_NATIVE_LVGL=y
```

## components/boards/esp32s3-devkitc/sdkconfig.defaults
```kconfig
CONFIG_IDF_TARGET="esp32s3"

# Override some defaults so BT stack is enabled
CONFIG_BT_ENABLED=y
CONFIG_BTDM_CTRL_MODE_BLE_ONLY=y
CONFIG_BTDM_CTRL_MODE_BR_EDR_ONLY=n
CONFIG_BTDM_CTRL_MODE_BTDM=n
CONFIG_BT_NIMBLE_ENABLED=y
CONFIG_BT_NIMBLE_TASK_STACK_SIZE=8192

CONFIG_ESP_RMAKER_FACTORY_PARTITION_NAME="nvs"

CONFIG_ESP_SYSTEM_EVENT_TASK_STACK_SIZE=4096

CONFIG_ESP32S3_SPIRAM_SUPPORT=y

CONFIG_ESPTOOLPY_FLASHMODE_QIO=y
CONFIG_ESPTOOLPY_FLASHSIZE_8MB=y

CONFIG_EXTENDED_VFS_SPI=n

CONFIG_LITTLEFS_FCNTL_GET_PATH=y
CONFIG_LITTLEFS_OPEN_DIR=y
CONFIG_LITTLEFS_SPIFFS_COMPAT=y

CONFIG_MBEDTLS_EXTERNAL_MEM_ALLOC=y

CONFIG_PARTITION_TABLE_CUSTOM=y
CONFIG_PARTITION_TABLE_CUSTOM_FILENAME="components/boards/esp32s3-devkitc/partitions.csv"

CONFIG_SPIRAM_MALLOC_ALWAYSINTERNAL=0
CONFIG_SPIRAM_MODE_OCT=y
CONFIG_SPIRAM_SPEED_80M=y

CONFIG_WASMACHINE_APP_MGR=y
```

## components/extended_vfs/Kconfig.wasmachine
```kconfig
menu "Extended VFS"
    config WASMACHINE_EXT_VFS
        bool "Enable Extended VFS for WASMachine"
        default y

    if WASMACHINE_EXT_VFS
        menu "Peripherals"
            config WASMACHINE_EXT_VFS_UART
                bool "UART"
                depends on !ESP_CONSOLE_UART_DEFAULT && !ESP_CONSOLE_UART_CUSTOM
                default y
                help
                    Select this option, then "/dev/uart/x" (x=0, 1, 2) will be registered
                    to VFS, but UART1 and UART2 are not initialized, so "/dev/uart/1" and
                    "/dev/uart/2" can't be used directly.

                    Besides above if users use UART0/1/2 for other functions, these devices
                    also can't be used.
            
            config WASMACHINE_EXT_VFS_GPIO
                bool "GPIO"
                default y
                help
                    Select this option, then "/dev/gpio/x" (x=0, 1, ...) will be registered
                    to VFS.
        endmenu
    endif
endmenu
```

## components/extended_wasm_native/Kconfig.wasmachine
```kconfig
menu "WASM Extended Native"
    config WASMACHINE_WASM_EXT_NATIVE
        bool "Enable Export WASM Extended Native"
        default y
    
    config WASMACHINE_WASM_EXT_NATIVE_LIBC
        bool "Export WASM extended libc native APIs"
        default y
        depends on WASMACHINE_WASM_EXT_NATIVE

    config WASMACHINE_WASM_EXT_NATIVE_MQTT
        bool "Export WASM extended mqtt native APIs"
        default y
        depends on WASMACHINE_WASM_EXT_NATIVE
    
    config WASMACHINE_WASM_EXT_NATIVE_LVGL
        bool "Export WASM extended LVGL native APIs"
        default y
        depends on WASMACHINE_WASM_EXT_NATIVE
endmenu
```

## components/shell/Kconfig.wasmachine
```kconfig
menu "Shell"
    config WASMACHINE_SHELL
        bool "Enable WASMachine Shell"
        default n

    if WASMACHINE_SHELL
        config WASMACHINE_SHELL_WASM_APP_STACK_SIZE
            string "WASM application default stack size"
            default "16384"
            help
                If WASM application's stack size is not set by `iwasm` command, this
                value will be used as the default stack size.

        config WASMACHINE_SHELL_WASM_APP_HEAP_SIZE
            string "WASM application default heap size"
            default "16384"
            help
                If WASM application's heap size is not set by `iwasm` command, this
                value will be used as the default heap size.

        config WASMACHINE_SHELL_WASM_TASK_STACK_SIZE
            int "WASM task stack size"
            default 8192
            help
                This stack size is used for WASM task in WASMachine side, this task
                will handle WASM application load logic.

        config WASMACHINE_SHELL_PROMPT
            string "Shell prompt"
            default "WASMachine>"

        menu "Shell Command List"
            config WASMACHINE_SHELL_CMD_FREE
                bool "free"
                default y

            config WASMACHINE_SHELL_CMD_IWASM
                bool "iwasm"
                default y
            
            config WASMACHINE_SHELL_CMD_INSTALL
                bool "install"
                default y
                depends on WASMACHINE_APP_MGR

            config WASMACHINE_SHELL_CMD_UNINSTALL
                bool "uninstall"
                default y
                depends on WASMACHINE_APP_MGR

            config WASMACHINE_SHELL_CMD_QUERY
                bool "query"
                default y
                depends on WASMACHINE_APP_MGR

            config WASMACHINE_SHELL_CMD_LS
                bool "ls"
                default y

            config WASMACHINE_SHELL_CMD_WIFI
                bool "sta"
                default y
        endmenu
    endif
endmenu
```

## components/wamr/Kconfig.wasmachine
```kconfig
menu "WASM Micro Runtime"
    config WAMR_ENABLE_AOT
        bool "AOT"
        default n
        depends on WAMR_PLATFORM_AOT_VAILD

    config WAMR_ENABLE_APP_FRAMEWORK
        bool "App Framework"
        default y

    config WAMR_APP_THREAD_STACK_SIZE_MAX
        int "Application thread max stack size"
        default 131072

    choice WAMR_BUILD_TYPE
        prompt "Build type"
        default WAMR_BUILD_RELEASE

        config WAMR_BUILD_RELEASE
            bool "Relase"

        config WAMR_BUILD_DEBUG
            bool "Debug"
    endchoice

    config WAMR_ENABLE_INTERP
        bool "Interpreter"
        default y

    menu "Interpreter Configuration"
        depends on WAMR_ENABLE_INTERP

        choice WAMR_INTERP_MODE
            prompt "Interpreter mode"
            default WAMR_INTERP_CLASSIC

            config WAMR_INTERP_CLASSIC
                bool "Classic"

            config WAMR_INTERP_FAST
                bool "Fast"
        endchoice

        choice WAMR_INTERP_LOADER_MODE
            prompt "Loader mode"
            default WAMR_INTERP_LOADER_NORMAL

            config WAMR_INTERP_LOADER_NORMAL
                bool "Normal"

            config WAMR_INTERP_LOADER_MINI
                bool "Mini"
        endchoice
    endmenu

    config WAMR_ENABLE_LIB_PTHREAD
        bool "Lib Pthread"
        default y

    config WAMR_ENABLE_LIBC_BUILTIN
        bool "Libc builtin"
        default y

    config WAMR_ENABLE_LIBC_WASI
        bool "libc WASI"
        default y

    config WAMR_ENABLE_MEMORY_PROFILING
        bool "Memory profiling"
        default n

    config WAMR_ENABLE_MULTI_MODULE
        bool "Multi module"
        default n

    config WAMR_ENABLE_PERF_PROFILING
        bool "Performance profiling"
        default n

    config WAMR_ENABLE_REF_TYPES
        bool "Reference types"
        default n

    config WAMR_ENABLE_SHARED_MEMORY
        bool "Shared memory"
        default n

    config WAMR_PLATFORM_AOT_VAILD
        bool
        default y if IDF_TARGET_ESP32 && FREERTOS_UNICORE 
        default n
        select ESP32_IRAM_AS_8BIT_ACCESSIBLE_MEMORY if IDF_TARGET_ESP32

endmenu
```

## components/wasmachine/Kconfig.projbuild
```kconfig
menu "WASMachine Configuration"
    rsource "../wasmachine/Kconfig.wasmachine"
    rsource "../extended_wasm_native/Kconfig.wasmachine"
    rsource "../extended_wasm_vfs/Kconfig.wasmachine"
    rsource "../shell/Kconfig.wasmachine"
endmenu
```

## components/wasmachine/Kconfig.wasmachine
```kconfig
menu "Generic"
    config WASMACHINE_APP_MGR
        bool "Enable WAMR APP Management"
        default n
        depends on WAMR_ENABLE_APP_FRAMEWORK

    if WASMACHINE_APP_MGR
        config WASMACHINE_TCP_SERVER
            bool "Enable TCP server"
            default y

        if WASMACHINE_TCP_SERVER
            config WASMACHINE_TCP_PORT
                int "TCP Port"
                default 8080
        endif
    endif

    config WASMACHINE_FILE_SYSTEM_BASE_PATH
        string "File-system base path"
        default "/storage"
endmenu
```

## components/wasmachine_core/Kconfig.projbuild
```kconfig
menu "WASMachine Configuration"
    orsource "../wasmachine_core/Kconfig.wasmachine"
    orsource "../espressif__wasmachine_core/Kconfig.wasmachine"
    orsource "../wasmachine_ext_wasm_native/Kconfig.wasmachine"
    orsource "../espressif__wasmachine_ext_wasm_native/Kconfig.wasmachine"
    orsource "../wasmachine_ext_wasm_vfs/Kconfig.wasmachine"
    orsource "../espressif__wasmachine_ext_wasm_vfs/Kconfig.wasmachine"
    orsource "../wasmachine_shell/Kconfig.wasmachine"
    orsource "../espressif__wasmachine_shell/Kconfig.wasmachine"
endmenu
```

## components/wasmachine_ext_wasm_native/Kconfig.wasmachine
```kconfig
menu "WASM Extended Native"
    config WASMACHINE_WASM_EXT_NATIVE
        bool "Enable Export WASM Extended Native"
        default y
    
    config WASMACHINE_WASM_EXT_NATIVE_LIBC
        bool "Export WASM extended libc native APIs"
        default y
        depends on WASMACHINE_WASM_EXT_NATIVE
    
    config WASMACHINE_WASM_EXT_NATIVE_LIBMATH
        bool "Export WASM extended libm native APIs"
        default y
        depends on WASMACHINE_WASM_EXT_NATIVE

    config WASMACHINE_WASM_EXT_NATIVE_HTTP_CLIENT
        bool "Export WASM extended HTTP client native APIs"
        default n
        depends on WASMACHINE_WASM_EXT_NATIVE

    config WASMACHINE_WASM_EXT_NATIVE_LVGL
        bool "Export WASM extended LVGL native APIs"
        default n
        depends on WASMACHINE_WASM_EXT_NATIVE

    config WASMACHINE_WASM_EXT_NATIVE_LVGL_USE_WASM_HEAP
        bool "Enable to allocate LVGL memory from WASM APP heap"
        default n
        depends on WASMACHINE_WASM_EXT_NATIVE && WASMACHINE_WASM_EXT_NATIVE_LVGL
        help
            When enabled, LVGL memory allocations are redirected to the WASM APP's heap
            instead of the system heap. This ensures memory isolation between different
            WASM applications and allows proper cleanup when an app is unloaded.

            Requires configNUM_THREAD_LOCAL_STORAGE_POINTERS >= 3 in FreeRTOS config.

    config WASMACHINE_WASM_EXT_NATIVE_MQTT
        bool "Export WASM extended MQTT native APIs"
        default n
        depends on WASMACHINE_WASM_EXT_NATIVE && WASMACHINE_APP_MGR

    config WASMACHINE_WASM_EXT_NATIVE_WIFI_PROVISIONING
        bool "Export WASM extended WiFi provisioning native APIs"
        default n
        depends on WASMACHINE_WASM_EXT_NATIVE

    orsource "../wasmachine_ext_wasm_native_rainmaker/Kconfig.wasmachine"
    orsource "../espressif__wasmachine_ext_wasm_native_rainmaker/Kconfig.wasmachine"
endmenu
```

## components/wasmachine_ext_wasm_native_rainmaker/Kconfig.wasmachine
```kconfig
config WASMACHINE_WASM_EXT_NATIVE_RMAKER
    bool "Export WASM extended RainMaker native APIs"
    default n
    depends on WASMACHINE_WASM_EXT_NATIVE
```

## examples/wasmachine/sdkconfig.defaults.esp32
```kconfig
CONFIG_ESPTOOLPY_FLASHMODE_QIO=y
CONFIG_ESPTOOLPY_FLASHSIZE_4MB=y

CONFIG_ESP_RMAKER_FACTORY_PARTITION_NAME="nvs"

CONFIG_PARTITION_TABLE_CUSTOM=y
CONFIG_PARTITION_TABLE_CUSTOM_FILENAME="partitions.4mb.single_app.csv"

CONFIG_SPIRAM=y
CONFIG_SPIRAM_MALLOC_ALWAYSINTERNAL=0
CONFIG_SPIRAM_TRY_ALLOCATE_WIFI_LWIP=y

CONFIG_MBEDTLS_EXTERNAL_MEM_ALLOC=y

CONFIG_FREERTOS_PLACE_FUNCTIONS_INTO_FLASH=y
CONFIG_RINGBUF_PLACE_FUNCTIONS_INTO_FLASH=y
CONFIG_ESP32_REV_MIN_3=y
```

## examples/wasmachine/sdkconfig.defaults.esp32c6
```kconfig
CONFIG_ESPTOOLPY_FLASHMODE_QIO=y
CONFIG_ESPTOOLPY_FLASHSIZE_4MB=y

CONFIG_ESP_RMAKER_FACTORY_PARTITION_NAME="nvs"

CONFIG_PARTITION_TABLE_CUSTOM=y
CONFIG_PARTITION_TABLE_CUSTOM_FILENAME="partitions.4mb.single_app.csv"
```

## examples/wasmachine/sdkconfig.defaults.esp32p4
```kconfig
CONFIG_ESPTOOLPY_FLASHMODE_QIO=y
CONFIG_ESPTOOLPY_FLASHSIZE_8MB=y

CONFIG_PARTITION_TABLE_CUSTOM=y
CONFIG_PARTITION_TABLE_CUSTOM_FILENAME="partitions.8mb.csv"

CONFIG_SPIRAM=y
CONFIG_SPIRAM_MALLOC_ALWAYSINTERNAL=0
CONFIG_SPIRAM_TRY_ALLOCATE_WIFI_LWIP=y

CONFIG_MBEDTLS_EXTERNAL_MEM_ALLOC=y

CONFIG_WASMACHINE_APP_MGR=n
CONFIG_WASMACHINE_SHELL=y
CONFIG_WASMACHINE_SHELL_CMD_WIFI=n
CONFIG_WASMACHINE_WASM_EXT_NATIVE_HTTP_CLIENT=n
CONFIG_WASMACHINE_WASM_EXT_NATIVE_MQTT=n
CONFIG_WASMACHINE_WASM_EXT_NATIVE_RMAKER=n
CONFIG_WASMACHINE_WASM_EXT_NATIVE_WIFI_PROVISIONING=n
CONFIG_EXAMPLE_CONNECT_WIFI=n
CONFIG_EXAMPLE_CONNECT_ETHERNET=n
```

## examples/wasmachine/sdkconfig.defaults.esp32s3
```kconfig
CONFIG_ESPTOOLPY_FLASHMODE_QIO=y
CONFIG_ESPTOOLPY_FLASHSIZE_8MB=y

CONFIG_PARTITION_TABLE_CUSTOM=y
CONFIG_PARTITION_TABLE_CUSTOM_FILENAME="partitions.8mb.csv"

CONFIG_SPIRAM=y
CONFIG_SPIRAM_MALLOC_ALWAYSINTERNAL=0
CONFIG_SPIRAM_MODE_OCT=y

CONFIG_MBEDTLS_EXTERNAL_MEM_ALLOC=y
```

## main/Kconfig.projbuild
```kconfig
menu "WASMachine Configuration"
    rsource "../components/extended_vfs/Kconfig.wasmachine"
    rsource "../components/wasmachine/Kconfig.wasmachine"
    rsource "../components/shell/Kconfig.wasmachine"
    rsource "../components/extended_wasm_native/Kconfig.wasmachine"
    rsource "../components/wamr/Kconfig.wasmachine"
endmenu
```

## sdkconfig.defaults
```kconfig
# Override some defaults so BT stack is enabled
CONFIG_BT_ENABLED=y
CONFIG_BT_NIMBLE_ENABLED=y
CONFIG_BT_NIMBLE_HOST_TASK_STACK_SIZE=8192

CONFIG_ESP_RMAKER_FACTORY_PARTITION_NAME="nvs"

CONFIG_ESP_SYSTEM_EVENT_TASK_STACK_SIZE=4096

CONFIG_FREERTOS_TIMER_TASK_STACK_DEPTH=3072

CONFIG_EXTENDED_VFS_SPI=n

CONFIG_LITTLEFS_FCNTL_GET_PATH=y
CONFIG_LITTLEFS_OPEN_DIR=y
CONFIG_LITTLEFS_SPIFFS_COMPAT=y

CONFIG_LWIP_SO_LINGER=y

CONFIG_WASMACHINE_APP_MGR=y
CONFIG_WASMACHINE_SHELL=y
CONFIG_WASMACHINE_WASM_EXT_NATIVE_HTTP_CLIENT=y
CONFIG_WASMACHINE_WASM_EXT_NATIVE_MQTT=y
CONFIG_WASMACHINE_WASM_EXT_NATIVE_RMAKER=y
CONFIG_WASMACHINE_WASM_EXT_NATIVE_WIFI_PROVISIONING=y
```

## sdkconfig.defaults.esp32s3
```kconfig
CONFIG_IDF_TARGET="esp32s3"

CONFIG_ESP32S3_SPIRAM_SUPPORT=y

CONFIG_ESPTOOLPY_FLASHMODE_QIO=y
CONFIG_ESPTOOLPY_FLASHSIZE_8MB=y

CONFIG_PARTITION_TABLE_CUSTOM=y
CONFIG_PARTITION_TABLE_CUSTOM_FILENAME="partitions.8mb.csv"

CONFIG_SPIRAM_MALLOC_ALWAYSINTERNAL=0
CONFIG_SPIRAM_MODE_OCT=y
```
